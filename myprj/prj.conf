## CMakeLists.txt
```
cmake_minimum_required(VERSION 3.20)

find_package(Zephyr REQUIRED HINTS $ENV{ZEPHYR_BASE})
project(my_test_app)

target_sources(app PRIVATE src/main.c)
```

## prj.conf
```kconfig
# ログ出力を有効にする（必要に応じて）
CONFIG_PRINTK=y
```

## src/main.c
```c
#include <zephyr/kernel.h>
#include <stdio.h>

int main(void)
{
	//add comment 1.
	//add comment 2.
	//add comment 3.
	//add comment 4.
	//add comment 5.
	//add comment 6.
	//add commmen t7.
	printf("Hello World! from Zephyr CI/CD\n");

	while (1) {
		k_msleep(1000);
		printf("Running...\n");
	}
	return 0;
}
```
